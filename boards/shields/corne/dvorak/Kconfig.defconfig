## boards/shields/corne/dvorak/Kconfig.defconfig
```kconfig
# Copyright (c) 2020 Pete Johanson
# SPDX-License-Identifier: MIT

if SHIELD_DVORAK_LEFT

config ZMK_KEYBOARD_NAME
    default "DVORAK"

config ZMK_SPLIT_ROLE_CENTRAL
    default y

endif

if SHIELD_DVORAK_LEFT || SHIELD_DVORAK_RIGHT

config ZMK_SPLIT
    default y

config ZMK_RGB_UNDERGLOW
    default y
    select SPI
    select WS2812_STRIP

endif
```

## boards/shields/corne/dvorak/Kconfig.shield
```kconfig
# Copyright (c) 2020 Pete Johanson
# SPDX-License-Identifier: MIT

config SHIELD_DVORAK_LEFT
    def_bool $(shields_list_contains,dvorak_left)

config SHIELD_DVORAK_RIGHT
    def_bool $(shields_list_contains,dvorak_right)
```

## boards/shields/corne/yoser/Kconfig.shield
```kconfig
# Copyright (c) 2020 Pete Johanson
# SPDX-License-Identifier: MIT

config SHIELD_YOSER_LEFT
    def_bool $(shields_list_contains,yoser_left)

config SHIELD_YOSER_RIGHT
    def_bool $(shields_list_contains,yoser_right)
```

## boards/shields/corne/ys/Kconfig.defconfig
```kconfig
# Copyright (c) 2020 Pete Johanson
# SPDX-License-Identifier: MIT

if SHIELD_YS_LEFT

config ZMK_KEYBOARD_NAME
    default "YS"

config ZMK_SPLIT_ROLE_CENTRAL
    default y

endif

if SHIELD_YS_LEFT || SHIELD_YS_RIGHT

config ZMK_SPLIT
    default y

config ZMK_RGB_UNDERGLOW
    default y
    select SPI
    select WS2812_STRIP

endif
```

## boards/shields/corne/ys/Kconfig.shield
```kconfig
# Copyright (c) 2020 Pete Johanson
# SPDX-License-Identifier: MIT

config SHIELD_YS_LEFT
    def_bool $(shields_list_contains,ys_left)

config SHIELD_YS_RIGHT
    def_bool $(shields_list_contains,ys_right)
```
